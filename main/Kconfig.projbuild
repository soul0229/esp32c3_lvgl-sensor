## main/Kconfig.projbuild
```kconfig
menu "Example Configuration"

    config EXAMPLE_WIFI_CONNECTION_MAXIMUM_RETRY
        int "WiFi connection maximum retry"
        range 0 255
        default 2
        help
            WiFi connection maximum retry, from 0 to 255.

    config CONTROL_DEVICE
        bool "device select"
        default n

    config BROKER_URL
        string "Broker URL"
        default "mqtt://bemfa.com:9501/"
        help
            URL of the broker to connect to

    config CLIENT_ID
        string "Client ID"
        default "0aa611a427fa4542956fead67f1f6859"
        help
            client id of the broker to connect to

    menu "I2C Master"
        config I2C_MASTER_SCL
            int "SCL GPIO Num"
            default 4
            help
                GPIO number for I2C Master clock line.

        config I2C_MASTER_SDA
            int "SDA GPIO Num"
            default 5
            help
                GPIO number for I2C Master data line.

        config I2C_MASTER_FREQUENCY
            int "Master Frequency"
            default 40000
            help
                I2C Speed of Master device.
    endmenu

    config BROKER_URL_FROM_STDIN
        bool
        default y if BROKER_URL = "FROM_STDIN"

endmenu
```
